## conf/machine/myd-lf25x.conf
```bitbake
#@TYPE: Machine
#@NAME: stm32mp2
#@DESCRIPTION: Configuration for all STM32MP2 boards (EV, DK, ...)
#@NEEDED_BSPLAYERS: layers/meta-openembedded/meta-oe layers/meta-openembedded/meta-python

# Define specific familly common machine name
MACHINEOVERRIDES =. "stm32mp2common:stm32mp25common:stm32mp23common:stm32mp21common:"
#MACHINEOVERRIDES =. "stm32mp2common:stm32mp25common"

include conf/machine/include/st-machine-common-stm32mp.inc
#include conf/machine/include/myir-machine-common-stm32mp.inc
include conf/machine/include/st-machine-providers-stm32mp.inc

MACHINENAME="myd-lf25x"
#COMBINED_FEATURES = "optee"
#DISTRO_FEATURES:append = " optee "
# =========================================================================
# Chip architecture
# =========================================================================
DEFAULTTUNE = "cortexa35"
include conf/machine/include/arm/armv8a/tune-cortexa35.inc

PREFERRED_PROVIDER_u-boot-fw-utils:stm32mp2common = "libubootenv"

MACHINE_EXTRA_RRECOMMENDS:append:stm32mp2common = " \
    u-boot-fw-config-stm32mp \
"
# =========================================================================
# boot scheme
# =========================================================================
BOOTSCHEME_LABELS = "optee"
#BOOTSCHEME_LABELS += "opteemin"
BOOTSCHEME_LABELS += "fastboot"
#BOOTSCHEME_LABELS += "fastboot-opteemin"

#secre signed
SIGN_KEY = "${DEPLOY_DIR_IMAGE}/stm32mp25-key/privateKey00.pem"
SIGN_KEY_stm32mp25 = "${DEPLOY_DIR_IMAGE}/stm32mp25-key/privateKey00.pem"
SIGN_KEY_stm32mp21 = "${DEPLOY_DIR_IMAGE}/stm32mp25-key/privateKey00.pem"
SIGN_KEY_stm32mp23 = "${DEPLOY_DIR_IMAGE}/stm32mp25-key/privateKey00.pem"
SIGN_KEY_PUB = "${DEPLOY_DIR_IMAGE}/stm32mp25-key/publicKey00.pem"
SIGN_M33DDR_KEY = "${DEPLOY_DIR_IMAGE}/stm32mp25-key/privateKey00.pem"
SIGN_M33DDR_KEY_PASS = "0000"
SIGN_M33FW_KEY = "${DEPLOY_DIR_IMAGE}/stm32mp25-key/privateKey00.pem"
SIGN_M33FW_KEY_PASS = "0000"
SIGN_COPRO_ECC_PRIVKEY = "${DEPLOY_DIR_IMAGE}/stm32mp25-key/privateKey00.pem"
SIGN_COPRO_ECC_INFOKEY = "${DEPLOY_DIR_IMAGE}/stm32mp25-key/publicKey00.der"
SIGN_COPRO_ECC_PASS = "0000"
EXTERNAL_KEY_CONF = "0"
STM32MP25_KEY_DEPENDS = "${@'stm32mp25-keys:do_keygen' if bb.data.inherits_class('sign-stm32mp', d) else ''}"
do_prepare_recipe_sysroot[depends] += "${STM32MP25_KEY_DEPENDS}"
SIGN_KEY_PASS = "0000"
SIGN_ENABLE = "1"
SIGN_TOOL = "${HOME}/STMicroelectronics/STM32Cube/STM32CubeProgrammer/bin/STM32_SigningTool_CLI"
# fsbl fip encrypt 
ENCRYPT_ENABLE = "1"
ENCRYPT_FSBL_KEY = "${DEPLOY_DIR_IMAGE}/stm32mp25-key/stm32mp_encryption_key.bin"
ENCRYPT_FSBL_KEY_stm32mp21 = "${DEPLOY_DIR_IMAGE}/stm32mp25-key/stm32mp_encryption_key.bin"
ENCRYPT_FSBL_KEY_stm32mp23 = "${DEPLOY_DIR_IMAGE}/stm32mp25-key/stm32mp_encryption_key.bin"
ENCRYPT_FSBL_KEY_stm32mp25 = "${DEPLOY_DIR_IMAGE}/stm32mp25-key/stm32mp_encryption_key.bin"
FIP_BL31_ENABLE = "1"
ENCRYPT_FIP_KEY = "${DEPLOY_DIR_IMAGE}/stm32mp25-key/stm32mp_encryption_key_256bits.bin"
ENCRYPT_FIP_KEY_stm32mp21 = "${DEPLOY_DIR_IMAGE}/stm32mp25-key/stm32mp_encryption_key_256bits.bin"
ENCRYPT_FIP_KEY_stm32mp23 = "${DEPLOY_DIR_IMAGE}/stm32mp25-key/stm32mp_encryption_key_256bits.bin"
ENCRYPT_FIP_KEY_stm32mp25 = "${DEPLOY_DIR_IMAGE}/stm32mp25-key/stm32mp_encryption_key_256bits.bin"
ENCRYPT_COPRO_KEY = "${DEPLOY_DIR_IMAGE}/stm32mp25-key/stm32mp_encryption_key.bin"
#OTA_SUPPORT = "1"

UBOOT_CONFIG[default_stm32mp25] = "myd_ld25x_1G_defconfig,,u-boot.dtb"
UBOOT_CONFIG[programmer_stm32mp25] = "myd_ld25x_1G_defconfig,,u-boot.dtb"

UBOOT_SIGN_ENABLE = "1"
#UBOOT_SIGN_KEYNAME = "dev"
UBOOT_SIGN_KEYNAME = "my-uboot-sign-key"
UBOOT_SIGN_IMG_KEYNAME = "my-uboot-image-sign-key"
UBOOT_SIGN_KEYDIR = "${DEPLOY_DIR_IMAGE}"
UBOOT_SIGN_DEPLOY = "0"
FIT_SIGN_INDIVIDUAL = "1"
#UBOOT_DTB_BINARY = "u-boot-myb-stm32mp257x-1GB.dtb"
UBOOT_DTB_SIGNED = ""
UBOOT_DTB_BINARY = ""
FIT_GENERATE_KEYS = "1"
UBOOT_MKIMAGE_DTCOPTS = "-I dts -O dtb -p 2000"

# =========================================================================
# boot device
# =========================================================================
# Define the boot device supported
BOOTDEVICE_LABELS += "emmc"
#BOOTDEVICE_LABELS += "nand-4-256-1024"
BOOTDEVICE_LABELS += "nor-sdcard"
BOOTDEVICE_LABELS += "sdcard"

IMAGE_ROOTFS_MAXSIZE = "4000000"
# =========================================================================
# Machine settings
# =========================================================================
# Define list of devicetree per supported storage
#STM32MP_DT_FILES_EMMC   += "stm32mp215f-dk"
#STM32MP_DT_FILES_SDCARD += "stm32mp215f-dk"

#STM32MP_DT_FILES_EMMC   += "stm32mp235f-dk"
#STM32MP_DT_FILES_SDCARD += "stm32mp235f-dk"

#kernel dtb
KERNEL_DEVICETREE += "myir/myb-stm32mp257x-1GB.dtb \
                      myir/myb-stm32mp257x-1GB-ethswitch.dtb \	
		   "
STM32MP_DT_FILES_EMMC   += "myb-stm32mp257x-1GB"
STM32MP_DT_FILES_SDCARD += "myb-stm32mp257x-1GB"

#STM32MP_DT_FILES_EMMC   += "stm32mp257f-ev1"
#STM32MP_DT_FILES_SDCARD += "stm32mp257f-ev1"
#STM32MP_DT_FILES_NOR    += "stm32mp257f-ev1"

EXTERNAL_DEVICETREE_SDCARD = ""
#EXTERNAL_DEVICETREE_SDCARD =+ "stm32mp215f-dk-ca35tdcid-ostl"
#EXTERNAL_DEVICETREE_SDCARD =+ "stm32mp215f-dk-ca35tdcid-ostl-m33-examples"
#EXTERNAL_DEVICETREE_SDCARD =+ "myb-stm32mp257x-2GB-ca35tdcid-ostl"
#EXTERNAL_DEVICETREE_SDCARD =+ "myb-stm32mp257x-2GB-ca35tdcid-ostl-m33-examples"
#EXTERNAL_DEVICETREE_SDCARD =+ "stm32mp257f-ev1-ca35tdcid-ostl"
#EXTERNAL_DEVICETREE_SDCARD =+ "stm32mp257f-ev1-ca35tdcid-ostl-m33-examples"
#EXTERNAL_DEVICETREE_SDCARD =+ "stm32mp257f-ev1-ca35tdcid-ostl-m33-examples-sram"

EXTERNAL_DEVICETREE_EMMC = ""
#EXTERNAL_DEVICETREE_EMMC =+ "stm32mp215f-dk-ca35tdcid-ostl"
#EXTERNAL_DEVICETREE_EMMC =+ "myb-stm32mp257x-2GB-ca35tdcid-ostl"
#EXTERNAL_DEVICETREE_EMMC =+ "myb-stm32mp257x-2GB-ca35tdcid-ostl-m33-examples"
#EXTERNAL_DEVICETREE_EMMC =+ "stm32mp257f-ev1-ca35tdcid-ostl"
#EXTERNAL_DEVICETREE_EMMC =+ "stm32mp257f-ev1-ca35tdcid-ostl-m33-examples"

# =========================================================================
# Machine features
# =========================================================================
MACHINE_FEATURES += "splashscreen"
MACHINE_FEATURES += "watchdog"
MACHINE_FEATURES += "bluetooth"
MACHINE_FEATURES += "wifi"

# GPU
MACHINE_FEATURES += "${@'gpu' if d.getVar('ACCEPT_EULA_'+d.getVar('MACHINE')) == '1' else ''}"
MACHINE_FEATURES += "${@'openvx' if d.getVar('ACCEPT_EULA_'+d.getVar('MACHINE')) == '1' else ''}"
MACHINE_FEATURES += "${@'opencl' if d.getVar('ACCEPT_EULA_'+d.getVar('MACHINE')) == '1' else ''}"
MACHINE_FEATURES += "${@'vulkan' if d.getVar('ACCEPT_EULA_'+d.getVar('MACHINE')) == '1' else ''}"

# M33
MACHINE_FEATURES += "m33copro"
# M0
MACHINE_FEATURES += "m0copro"

# Bluetooth
BLUETOOTH_LIST += "linux-firmware-addons-bcm43xx"
# Wifi
WIFI_LIST += "linux-firmware-addons-bcm43xx"

# activate external dt
EXTERNAL_DT_ENABLED = "1"
MACHINE_FEATURES += "${@bb.utils.contains('UBOOT_SIGN_ENABLE', '1', 'fit', '', d)}"
UBOOT_ENTRYPOINT = "${@bb.utils.contains('UBOOT_SIGN_ENABLE', '1', '0x84000000', '', d)}"

# ==========================================================================
# M33 Boards
# ==========================================================================
# Lists of boards/devicetree on which the m33 service MUST be started
M33_BOARDS_START_AT_STARTUP = "stm32mp257f-dk stm32mp257f-ev1"
M33_BOARDS_START_AT_STARTUP =+ "stm32mp235f-dk"
M33_BOARDS_START_AT_STARTUP =+ "${@bb.utils.contains('EXTERNAL_DT_ENABLED', '1', 'stm32mp257f-dk-ca35tdcid-ostl', '', d)}"
M33_BOARDS_START_AT_STARTUP =+ "${@bb.utils.contains('EXTERNAL_DT_ENABLED', '1', 'stm32mp257f-ev1-ca35tdcid-ostl', '', d)}"

# supported m33fw board:
#          stm32mp215f-dk
M33FW_BOARDS += "stm32mp215f-dk"
# project name on m33tdprojects-starter-stm32mp2 to build
# M33FW_FIRMWARE[config_m33fw_board] ?= "<project_path>,<project_name>
M33FW_FIRMWARE[stm32mp215f-dk] ?= "Projects/STM32MP215F-DK/Demonstrations/OpenAMP/OpenAMP_TTY_echo,OpenAMP_TTY_echo"
# Default project to used
M33FW_DEFAULT_FIRMWARE[stm32mp215f-dk] ?= ""
# Define tf-m platform path
M33FW_TFM_PLATFORM[stm32mp215f-dk] ?= "stm/stm32mp215f_dk"
# Define tf-m platform extra opts config
M33FW_TFM_OPTFLAGS[stm32mp215f-dk] ?= "-DTFM_PARTITION_PROTECTED_STORAGE=OFF -DTFM_PARTITION_PLATFORM=ON"

# supported m33fw board:
#          stm32mp235f-dk
M33FW_BOARDS += "stm32mp235f-dk"
# project name on m33tdprojects-starter-stm32mp2
# M33FW_FIRMWARE[config_m33fw_board] ?= "<project_path>,<project_name>
M33FW_FIRMWARE[stm32mp235f-dk] ?= "Projects/STM32MP235F-DK/Demonstrations/USBPD_DRP_UCSI,USBPD_DRP_UCSI"
# Default project to used
M33FW_DEFAULT_FIRMWARE[stm32mp235f-dk] ?= "USBPD_DRP_UCSI"
# Define tf-m platform path
M33FW_TFM_PLATFORM[stm32mp235f-dk] ?= "stm/stm32mp235f_dk"
# Define tf-m platform extra opts config
M33FW_TFM_OPTFLAGS[stm32mp235f-dk] ?= "-DTFM_PARTITION_PROTECTED_STORAGE=OFF"

# supported m33fw board:
#          stm32mp257f-dk
M33FW_BOARDS += "stm32mp257f-dk"
# project name on m33tdprojects-starter-stm32mp2
# M33FW_FIRMWARE[config_m33fw_board] ?= "<project_path>,<project_name>
M33FW_FIRMWARE[stm32mp257f-dk] ?= "Projects/STM32MP257F-DK/Demonstrations/USBPD_DRP_UCSI,USBPD_DRP_UCSI"
# Default project to used
M33FW_DEFAULT_FIRMWARE[stm32mp257f-dk] ?= "USBPD_DRP_UCSI"
# Define tf-m platform path
M33FW_TFM_PLATFORM[stm32mp257f-dk] ?= "stm/stm32mp257f_dk"
# Define tf-m platform extra opts config
M33FW_TFM_OPTFLAGS[stm32mp257f-dk] ?= "-DTFM_PARTITION_PROTECTED_STORAGE=OFF"

# supported m33fw board:
#          stm32mp257f-ev1
M33FW_BOARDS += "stm32mp257f-ev1"
# project name on m33tdprojects-starter-stm32mp2
# M33FW_FIRMWARE[config_m33fw_board] ?= "<project_path>,<project_name>
M33FW_FIRMWARE[stm32mp257f-ev1] ?= "\
    Projects/STM32MP257F-EV1/Demonstrations/USBPD_DRP_UCSI,USBPD_DRP_UCSI \
    Projects/STM32MP257F-EV1/Demonstrations/LowPower_SRAM_Demo,LowPower_SRAM_Demo \
    "
# Default project to used
M33FW_DEFAULT_FIRMWARE[stm32mp257f-ev1] ?= "USBPD_DRP_UCSI"
# Define tf-m platform path
M33FW_TFM_PLATFORM[stm32mp257f-ev1] ?= "stm/stm32mp257f_ev1"
# Define tf-m platform extra opts config
M33FW_TFM_OPTFLAGS[stm32mp257f-ev1] ?= "-DTEST_NS_PS=OFF"

# =========================================================================
# OPTEE
# =========================================================================
# For sdk generation, declare the default board configuration to use.
#ST_OPTEE_EXPORT_TA_REF_BOARD:stm32mp2common = "stm32mp257f-dk.dts"
#2G DDR
ST_OPTEE_EXPORT_TA_REF_BOARD:stm32mp2common = "myb-stm32mp257x-2GB.dts"
#1G DDR
ST_OPTEE_EXPORT_TA_REF_BOARD:stm32mp2common = "myb-stm32mp257x-1GB.dts"

DISK_DRIVE = "/dev/mmcblk1"
# Set time zone
DEFAULT_TIMEZONE = "Asia/Shanghai"
WIC_CREATE_EXTRA_ARGS = "--no-fstab-update"
WKS_FILE_DEPENDS ?= " \
    virtual/bootloader \
    virtual/trusted-firmware-a \
    virtual-optee-os \
    ${@bb.utils.contains('ST_BOOTFS','1','st-image-bootfs', '', d)} \
    ${@bb.utils.contains('ST_VENDORFS','1','st-image-vendorfs', '', d)} \
    ${@bb.utils.contains('ST_USERFS','1','st-image-userfs', '', d)} \
"
OPTEE_WIC_FILE = "${@bb.utils.contains('ENCRYPT_ENABLE','1','sdcard-myd-lf25x-encrypt-optee-vendorfs-1GB.wks','sdcard-myd-lf25x-optee-vendorfs-1GB.wks',d)}"

# for generated a WIC file, please uncomment the 2 following lines or add them to local.conf
WKS_IMAGE_FSTYPES += "wic wic.bz2 wic.bmap"
WKS_FILE += "${OPTEE_WIC_FILE}"

# use default static flashlayout
#ENABLE_FLASHLAYOUT_DEFAULT = "1"
ENABLE_FLASHLAYOUT_DEFAULT = "${@bb.utils.contains('OTA_SUPPORT', '1', '1', '0', d)}"
FLASHLAYOUT_DEFAULT_SRC = " \
   ${@bb.utils.contains('ENCRYPT_ENABLE','1','files/flashlayouts/optee/FlashLayout_emmc_myb-stm32mp257x-1GB-optee-ota-encrypt.tsv files/flashlayouts/optee/FlashLayout_sdcard_myb-stm32mp257x-1GB-optee-ota-encrypt-full.tsv files/flashlayouts/optee/FlashLayout_sdcard_myb-stm32mp257x-1GB-optee-ota-encrypt.tsv','files/flashlayouts/optee/FlashLayout_emmc_myb-stm32mp257x-1GB-optee-ota.tsv files/flashlayouts/optee/FlashLayout_sdcard_myb-stm32mp257x-1GB-optee-ota.tsv',d)} \
"
UBOOT_EXTLINUX_KERNEL_ARGS:append = " ${@bb.utils.contains('OTA_SUPPORT', '1', 'rauc.slot=A', '', d)}"
```
