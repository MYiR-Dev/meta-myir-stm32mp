## conf/machine/myd-yf13f.conf
```bitbake
#@TYPE: Machine
#@NAME: stm32mp1
#@DESCRIPTION: Configuration for all STM32MP1 boards (EV, DK, ...)
#@NEEDED_BSPLAYERS: layers/meta-openembedded/meta-oe layers/meta-openembedded/meta-python

# Define specific familly common machine name
MACHINEOVERRIDES =. "stm32mp1common:stm32mp13common:"

include conf/machine/include/myir-machine-common-stm32mp.inc
include conf/machine/include/st-machine-providers-stm32mp.inc

# =========================================================================
# Chip architecture
# =========================================================================
DEFAULTTUNE = "cortexa7thf-neon-vfpv4"
include conf/machine/include/arm/armv7a/tune-cortexa7.inc
MACHINEOVERRIDES .= ":emmc"
MACHINEOVERRIDES .= ":sdcard"
# =========================================================================
# boot scheme
# =========================================================================
BOOTSCHEME_LABELS += "optee"

UBOOT_CONFIG[default_stm32mp13] ?= "myc_stm32mp13_512m_defconfig,,u-boot.dtb"
UBOOT_CONFIG[programmer_stm32mp13] = "myc_stm32mp13_512m_defconfig,,u-boot.dtb"
#
DISTRO_FEATURES:remove = "pipewire"

#secre signed
SIGN_KEY = "${DEPLOY_DIR_IMAGE}/stm32mp13-key/privateKey00.pem"
SIGN_KEY_stm32mp13 = "${DEPLOY_DIR_IMAGE}/stm32mp13-key/privateKey00.pem"
EXTERNAL_KEY_CONF = "1"
SIGN_KEY_PASS = "0000"
SIGN_ENABLE = "0"
SIGN_TOOL = "${HOME}/STMicroelectronics/STM32Cube/STM32CubeProgrammer/bin/STM32_SigningTool_CLI"
# fsbl fip encrypt 
ENCRYPT_ENABLE = "0"
ENCRYPT_FSBL_KEY = "${DEPLOY_DIR_IMAGE}/stm32mp13-key/stm32mp13_encryption_key.bin"
#FIP_BL31_ENABLE = "1"
ENCRYPT_FIP_KEY = "${DEPLOY_DIR_IMAGE}/stm32mp13-key/stm32mp13_encryption_key_256bits.bin"
OTA_SUPPORT = "0"

UBOOT_SIGN_ENABLE = "0"
#UBOOT_SIGN_KEYNAME = "dev"
UBOOT_SIGN_KEYNAME = "my-uboot-sign-key"
UBOOT_SIGN_IMG_KEYNAME = "my-uboot-image-sign-key"
UBOOT_SIGN_KEYDIR = "${DEPLOY_DIR_IMAGE}"
#UBOOT_SIGN_DEPLOY = "0"
FIT_SIGN_INDIVIDUAL = "1"
UBOOT_DTB_BINARY = "u-boot-myb-stm32mp135x-512m-default.dtb"
FIT_GENERATE_KEYS = "1"
UBOOT_MKIMAGE_DTCOPTS = "-I dts -O dtb -p 2000"

# =========================================================================
# boot device
# =========================================================================
# Define the boot device supported
BOOTDEVICE_LABELS += "emmc"
BOOTDEVICE_LABELS += "sdcard"

FLASHLAYOUT_PARTITION_ENABLE:emmc:${STM32MP_SSBL1_NAME} = "PD"
FLASHLAYOUT_PARTITION_ENABLE:sdcard:${STM32MP_SSBL1_NAME} = "P"
FLASHLAYOUT_PARTITION_ENABLE:sdcard:${STM32MP_METADATA_NAME} = "P"
STM32MP_BOOTFS_SIZE       = "36864"

FLASHLAYOUT_PARTITION_OFFSET:sdcard:${STM32MP_FSBL0_NAME} = "${DEVICE_START_OFFSET:SDCARD}"
FLASHLAYOUT_PARTITION_OFFSET:sdcard:${STM32MP_FSBL0_NAME}2 = "${DEVICE_START_OFFSET:EMMC}"

# =========================================================================
# Machine settings
# =========================================================================
# Define list of devicetree per supported storage
STM32MP_DT_FILES_EMMC += "myb-stm32mp135x-512m"
STM32MP_DT_FILES_SDCARD += "myb-stm32mp135x-512m"
EXTERNAL_DT_ENABLED = "0"
MACHINE_FEATURES += "${@bb.utils.contains('UBOOT_SIGN_ENABLE', '1', 'fit', '', d)}"

#UBOOT_EXTLINUX_DEFAULT_LABEL:myb-stm32mp135x-512m = "myb-stm32mp135x-512m-emmc"
# =========================================================================
# Machine features
# =========================================================================
MACHINE_FEATURES += "splashscreen"
MACHINE_FEATURES += "watchdog"
MACHINE_FEATURES += "bluetooth"
MACHINE_FEATURES += "wifi"
MACHINE_FEATURES += "nosmp"
MACHINE_FEATURES += "usbg0"
MACHINE_FEATURES += "${@'gpu' if d.getVar('ACCEPT_EULA_'+d.getVar('MACHINE')) == '1' else ''}"

# Bluetooth
BLUETOOTH_LIST += "linux-firmware-addons-bcm43xx"
# Wifi
WIFI_LIST += "linux-firmware-addons-bcm43xx"

# =========================================================================
# Kernel
# =========================================================================
# For eval board: auto-load goodix module (touchscreen module)
KERNEL_MODULE_AUTOLOAD = "goodix"

# Define the devicetree for Linux A7 examples

LINUX_A7_EXAMPLES_DT += "stm32mp135f-dk-a7-examples"

# =========================================================================
# M4 copro
# =========================================================================
# Define the devicetree for M4 example
#CUBE_M4_EXAMPLES_DT += "stm32mp157d-dk1-m4-examples"
#CUBE_M4_EXAMPLES_DT += "stm32mp157c-dk2-m4-examples"
#CUBE_M4_EXAMPLES_DT += "stm32mp157c-ev1-m4-examples"
#CUBE_M4_EXAMPLES_DT += "stm32mp157f-dk2-m4-examples"
#CUBE_M4_EXAMPLES_DT += "stm32mp157f-ev1-m4-examples"

# =========================================================================
# OPTEE
# =========================================================================
# For sdk generation, declare the default board configuration to use.
#ST_OPTEE_EXPORT_TA_REF_BOARD:stm32mp1common = "stm32mp135f-dk.dts"
ST_OPTEE_EXPORT_TA_REF_BOARD:stm32mp1common ?= "myb-stm32mp135x-512m.dts"

DEFAULT_TIMEZONE = "Asia/Shanghai"

WIC_CREATE_EXTRA_ARGS = "--no-fstab-update"
WKS_FILE_DEPENDS ?= " \
    virtual/bootloader \
    virtual/trusted-firmware-a \
    ${@bb.utils.contains('BOOTSCHEME_LABELS', 'optee', 'virtual-optee-os', '', d)} \
    ${@bb.utils.contains('ST_BOOTFS','1','st-image-bootfs', '', d)} \
    ${@bb.utils.contains('ST_VENDORFS','1','st-image-vendorfs', '', d)} \
    ${@bb.utils.contains('ST_USERFS','1','st-image-userfs', '', d)} \
"

OPTEE_WIC_FILE = "${@bb.utils.contains('ENCRYPT_ENABLE','1','sdcard-myd-yf13x-optee-vendorfs-secure.wks.in','sdcard-myd-yf13x-optee-vendorfs.wks.in',d)}"
# for generated a WIC file, please uncomment the 2 following lines or add them to local.conf
WKS_IMAGE_FSTYPES += "wic wic.bz2 wic.bmap"
WKS_FILE += "${OPTEE_WIC_FILE}"


# use default static flashlayout
ENABLE_FLASHLAYOUT_DEFAULT = "${@bb.utils.contains('OTA_SUPPORT', '1', '1', '0', d)}"
FLASHLAYOUT_DEFAULT_SRC = " \
    ${@bb.utils.contains('ENCRYPT_ENABLE','1','files/flashlayouts/optee/FlashLayout_emmc_myb-stm32mp135x-512m-optee-ota-encrypt.tsv files/flashlayouts/optee/FlashLayout_sdcard_myb-stm32mp135x-512m-optee-ota-encrypt.tsv','',d)} \
"
UBOOT_EXTLINUX_KERNEL_ARGS:append = " ${@bb.utils.contains('OTA_SUPPORT', '1', 'rauc.slot=A', '', d)}"
```

## conf/machine/myd-yf13x.conf
```bitbake
#@TYPE: Machine
#@NAME: stm32mp1
#@DESCRIPTION: Configuration for all STM32MP1 boards (EV, DK, ...)
#@NEEDED_BSPLAYERS: layers/meta-openembedded/meta-oe layers/meta-openembedded/meta-python

# Define specific familly common machine name
MACHINEOVERRIDES =. "stm32mp1common:stm32mp13common:"

include conf/machine/include/st-machine-common-stm32mp.inc
include conf/machine/include/st-machine-providers-stm32mp.inc

# =========================================================================
# Chip architecture
# =========================================================================
DEFAULTTUNE = "cortexa7thf-neon-vfpv4"
include conf/machine/include/arm/armv7a/tune-cortexa7.inc
MACHINEOVERRIDES .= ":emmc"
MACHINEOVERRIDES .= ":sdcard"
MACHINEOVERRIDES .= ":nand_2_128_256"
MACHINEOVERRIDES .= ":nand_4_256_512"

MACHINENAME = "myd-yf13x"
# =========================================================================
# boot scheme
# =========================================================================
BOOTSCHEME_LABELS += "optee"
BOOTSCHEME_LABELS += "opteemin"

UBOOT_CONFIG[myd_yf13x_emmc] = "myc_stm32mp13_512m_defconfig,,u-boot.dtb"
UBOOT_CONFIG[myd_yf13x_nand] = "myc_stm32mp13_256m_defconfig,,u-boot.dtb"
UBOOT_CONFIG[myd_yf13x_nand_512n512d] = "myc_stm32mp13_512n512d_defconfig,,u-boot.dtb"
UBOOT_DEVICETREE[myd_yf13x_emmc] = "${@' '.join(dt for dt in '${STM32MP_DEVICETREE}'.split() if 'stm32mp13' in dt)}"
UBOOT_DEVICETREE[myd_yf13x_nand] = "${@' '.join(dt for dt in '${STM32MP_DEVICETREE}'.split() if 'stm32mp13' in dt)}"
UBOOT_DEVICETREE[myd_yf13x_nand_512n512d] = "${@' '.join(dt for dt in '${STM32MP_DEVICETREE}'.split() if 'stm32mp13' in dt)}"
UBOOT_MAKE_OPT[myd_yf13_emmc] = "${UBOOT_EXTERNALDT_opt}"
UBOOT_MAKE_OPT[myd_yf13_nand] = "${UBOOT_EXTERNALDT_opt}"
UBOOT_MAKE_OPT[myd_yf13_nand_512n512d] = "${UBOOT_EXTERNALDT_opt}"

UBOOT_CONFIG[programmer_stm32mp13] = "myc_stm32mp13_512m_defconfig,,u-boot.dtb"
UBOOT_CONFIG[programmer_nand_stm32mp13] = "myc_stm32mp13_256m_defconfig,,u-boot.dtb"
UBOOT_DEVICETREE[programmer_nand_stm32mp13] = "${@' '.join(dt for dt in '${STM32MP_DEVICETREE_PROGRAMMER}'.split() if 'stm32mp13' in dt)}"
UBOOT_MAKE_OPT[programmer_nand_stm32mp13] = "${UBOOT_EXTERNALDT_SERIAL_opt}"
#UBOOT_DEVICETREE[default_stm32mp13] ?= "${@' '.join(dt for dt in '${STM32MP_DEVICETREE}'.split() if 'stm32mp13' in dt)}"
#
DISTRO_FEATURES:remove = "pipewire"

# =========================================================================
# boot device
# =========================================================================
# Define the boot device supported
BOOTDEVICE_LABELS += "emmc"
#BOOTDEVICE_LABELS += "nand-4-256-1024"
BOOTDEVICE_LABELS += "nand-2-128-256"
BOOTDEVICE_LABELS += "nand-4-256-512"
#BOOTDEVICE_LABELS += "nand-4-256-1024-sdcard"
#BOOTDEVICE_LABELS += "nor-sdcard"
BOOTDEVICE_LABELS += "sdcard"

FLASHLAYOUT_PARTITION_ENABLE:emmc:${STM32MP_SSBL1_NAME} = "PD"
FLASHLAYOUT_PARTITION_ENABLE:sdcard:${STM32MP_SSBL1_NAME} = "P"
FLASHLAYOUT_PARTITION_ENABLE:sdcard:${STM32MP_METADATA_NAME} = "P"
FLASHLAYOUT_PARTITION_ENABLE:nand-2-128-256 = "P"
FLASHLAYOUT_PARTITION_ENABLE:nand-2-128-256:${STM32MP_FSBL_PROGRAMMER_NAME} = "-"
FLASHLAYOUT_PARTITION_ENABLE:nand-2-128-256:${STM32MP_SSBL1_PROGRAMMER_NAME} = "-"
FLASHLAYOUT_PARTITION_ENABLE:nand-2-128-256:${STM32MP_SSBL2_PROGRAMMER_NAME} = "-"
FLASHLAYOUT_PARTITION_ENABLE:nand-4-256-512 = "P"
FLASHLAYOUT_PARTITION_ENABLE:nand-4-256-512:${STM32MP_FSBL_PROGRAMMER_NAME} = "-"
FLASHLAYOUT_PARTITION_ENABLE:nand-4-256-512:${STM32MP_SSBL1_PROGRAMMER_NAME} = "-"
FLASHLAYOUT_PARTITION_ENABLE:nand-4-256-512:${STM32MP_SSBL2_PROGRAMMER_NAME} = "-"
STM32MP_ROOTFS_SIZE:nand_2_128_256 = "195000"
STM32MP_ROOTFS_SIZE:nand_4_256_512 = "438000"
NAND_VENDORFS:nand_2_128_256 = "0"
NAND_USERFS:nand_2_128_256   = "0"
STM32MP_BOOTFS_SIZE       = "36864"
NAND_VENDORFS:nand_4_256_512 = "0"
NAND_USERFS:nand_4_256_512   = "0"
DEVICE_MAX_OFFSET:SPINAND     = "0x20000000"

FLASHLAYOUT_PARTITION_OFFSET:nand_2_128_256:${STM32MP_FSBL1_NAME} = "${DEVICE_START_OFFSET:SPINAND}"
FLASHLAYOUT_PARTITION_OFFSET:nand_2_128_256:${STM32MP_FSBL2_NAME} = "${DEVICE_START_OFFSET:EMMC}"
FLASHLAYOUT_PARTITION_OFFSET:nand_4_256_512:${STM32MP_FSBL1_NAME} = "${DEVICE_START_OFFSET:SPINAND}"
FLASHLAYOUT_PARTITION_OFFSET:nand_4_256_512:${STM32MP_FSBL2_NAME} = "${DEVICE_START_OFFSET:EMMC}"
#FLASHLAYOUT_PARTITION_OFFSET:emmc:${STM32MP_FSBL1_NAME} = "${DEVICE_START_OFFSET_BOOT0:EMMC}"
FLASHLAYOUT_PARTITION_OFFSET:sdcard:${STM32MP_FSBL0_NAME} = "${DEVICE_START_OFFSET:SDCARD}"
FLASHLAYOUT_PARTITION_OFFSET:sdcard:${STM32MP_FSBL0_NAME}2 = "${DEVICE_START_OFFSET:EMMC}"

# =========================================================================
# Machine settings
# =========================================================================
# Define list of devicetree per supported storage
STM32MP_DT_FILES_EMMC += "myb-stm32mp135x-512m"
STM32MP_DT_FILES_NAND += "myb-stm32mp135x-256m"

STM32MP_DT_FILES_SDCARD += "myb-stm32mp135x-512m"
STM32MP_DT_FILES_SDCARD += "myb-stm32mp135x-256m"
STM32MP_DT_FILES_SDCARD += "myb-stm32mp135x-512n512d"
STM32MP_DT_FILES_SPINAND += "myb-stm32mp135x-256m"
STM32MP_DT_FILES_SPINAND += "myb-stm32mp135x-512n512d"
EXTERNAL_DT_ENABLED = "0"

UBOOT_EXTLINUX_LABELS += "myb-stm32mp135x-512n512d-nand"
UBOOT_EXTLINUX_DEFAULT_LABEL:myb-stm32mp135x-512n512d-nand = "myb-stm32mp135x-512n512d-nand"
UBOOT_EXTLINUX_TARGETS_EXTRA_CONFIG[myb-stm32mp135x-512n512d] = "myb-stm32mp135x-512n512d-nand"
UBOOT_EXTLINUX_FDT:myb-stm32mp135x-512n512d-nand = "/myb-stm32mp135x-512n512d.dtb"

UBOOT_EXTLINUX_LABELS += "myb-stm32mp135x-512n512d-sdcard"
UBOOT_EXTLINUX_DEFAULT_LABEL:myb-stm32mp135x-512n512d-sdcard = "myb-stm32mp135x-512n512d-sdcard"
UBOOT_EXTLINUX_TARGETS_EXTRA_CONFIG[myb-stm32mp135x-512m512d] = "myb-stm32mp135x-512n512d-sdcard"
UBOOT_EXTLINUX_FDT:myb-stm32mp135x-512n512d-sdcard = "/myb-stm32mp135x-512n512d.dtb"

#UBOOT_EXTLINUX_DEFAULT_LABEL:myb-stm32mp135x-512m = "myb-stm32mp135x-512m-emmc"
# =========================================================================
# Machine features
# =========================================================================
MACHINE_FEATURES += "splashscreen"
MACHINE_FEATURES += "watchdog"
MACHINE_FEATURES += "bluetooth"
MACHINE_FEATURES += "wifi"
MACHINE_FEATURES += "nosmp"
MACHINE_FEATURES += "usbg0"
MACHINE_FEATURES += "${@'gpu' if d.getVar('ACCEPT_EULA_'+d.getVar('MACHINE')) == '1' else ''}"

# Bluetooth
BLUETOOTH_LIST += "linux-firmware-addons-bcm43xx"
# Wifi
WIFI_LIST += "linux-firmware-addons-bcm43xx"

# =========================================================================
# Kernel
# =========================================================================
# For eval board: auto-load goodix module (touchscreen module)
KERNEL_MODULE_AUTOLOAD = "goodix"

# Define the devicetree for Linux A7 examples

LINUX_A7_EXAMPLES_DT += "stm32mp135f-dk-a7-examples"

# =========================================================================
# M4 copro
# =========================================================================
# Define the devicetree for M4 example
#CUBE_M4_EXAMPLES_DT += "stm32mp157d-dk1-m4-examples"
#CUBE_M4_EXAMPLES_DT += "stm32mp157c-dk2-m4-examples"
#CUBE_M4_EXAMPLES_DT += "stm32mp157c-ev1-m4-examples"
#CUBE_M4_EXAMPLES_DT += "stm32mp157f-dk2-m4-examples"
#CUBE_M4_EXAMPLES_DT += "stm32mp157f-ev1-m4-examples"

# =========================================================================
# OPTEE
# =========================================================================
# For sdk generation, declare the default board configuration to use.
#ST_OPTEE_EXPORT_TA_REF_BOARD:stm32mp1common = "stm32mp135f-dk.dts"
ST_OPTEE_EXPORT_TA_REF_BOARD:stm32mp1common ?= "myb-stm32mp135x-512m.dts"

DEFAULT_TIMEZONE = "Asia/Shanghai"

WIC_CREATE_EXTRA_ARGS = "--no-fstab-update"
WKS_FILE_DEPENDS ?= " \
    virtual/bootloader \
    virtual/trusted-firmware-a \
    ${@bb.utils.contains('BOOTSCHEME_LABELS', 'optee', 'virtual-optee-os', '', d)} \
    ${@bb.utils.contains('ST_BOOTFS','1','st-image-bootfs', '', d)} \
    ${@bb.utils.contains('NAND_VENDORFS','1','st-image-vendorfs-nand', '', d)} \
    ${@bb.utils.contains('NAND_USERFS','1','st-image-userfs-nand', '', d)} \
"
OPTEE_WIC_FILE ?= "${@bb.utils.contains('ST_VENDORFS','1','sdcard-myd-yf13x-optee-vendorfs-1GB.wks.in','sdcard-stm32mp135f-dk-optee-1GB.wks.in',d)}"
```
